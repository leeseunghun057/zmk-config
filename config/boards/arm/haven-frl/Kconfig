## config/boards/arm/haven-frl/Kconfig
```kconfig
config NRF_STORE_REBOOT_TYPE_GPREGRET
    bool "NRF_STORE_REBOOT_TYPE_GPREGRET
    default n
```

## config/boards/arm/haven-frl/Kconfig.board
```kconfig
# Copyright (c) 2020 The ZMK Contributors
# SPDX-License-Identifier: MIT

config BOARD_HAVENFRL
	bool "haven-frl"
	depends on SOC_NRF52840_QIAA
```
