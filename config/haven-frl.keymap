/*
 * Copyright (c) 2022 The ZMK Contributors
 *
 * SPDX-License-Identifier: MIT
 */

#include <behaviors.dtsi>
#include <dt-bindings/zmk/bt.h>
#include <dt-bindings/zmk/keys.h>
#include <dt-bindings/zmk/outputs.h>
{
    keymap0: keymap {
        compatible = "zmk,keymap";

        ht: holdtap {
            compatible = "zmk,behavior-hold-tap";
            #binding-cells = <2>;
            tapping-term-ms = <150>;
            flavor = "tap-preferred";
            bindings = <&kp>, <&kp>;
        };

        htL: holdtapL {
            compatible = "zmk,behavior-hold-tap";
            #binding-cells = <2>;
            tapping-term-ms = <150>;
            quick-tap-ms = <200>;
            flavor = "tap-preferred";
            bindings = <&kp>, <&kp>;
        };
    };
};


/ {


        layer0 {

            //----------------------------------------------------------------------------------------------------------------------------
            //| - | * | / | ` |  | ESC |  1  |  2  |  3  |  4  |  5  |  6  |  7  |  8  |  9  |  0  |  -  |  =  |   BKSP   |  | I | H | U |
            //| + | 9 | 8 | 7 |  | TAB  |  Q  |  W  |  E  |  R  |  T  |  Y  |  U  |  I  |  O  |  P  |  [  |  ]  |    \    |  | D | E | D |
            //| + | 6 | 5 | 4 |  | CAPS  |  A  |  S  |  D  |  F  |  G  |  H  |  J  |  K  |  L  |  ;  |  '  |     ENTER    |   
            //| E | 3 | 2 | 1 |  |  SHIFT  |  Z  |  X  |  C  |  V  |  B  |  N  |  M  |  ,  |  .  |  /  |      SHIFT       |      | U |
            //| T | . |   0   |  |  CTL  |  WIN  |  ALT  |            SPACE                  |  ALT   |   MO(1)  |  CTRL  |  | L | D | R |
            //----------------------------------------------------------------------------------------------------------------------------

            bindings = <
                &kp KP_MINUS &kp KP_MULTIPLY      &kp KP_SLASH       &kp GRAVE                &kp ESC  &ht F1 N1 &ht F2 N2 &ht F3 N3 &ht F4 N4 &ht F5 N5 &ht F6 N6 &ht F7 N7  &ht F8 N8 &ht F9 N9 &ht F10 N0 &ht F11 MINUS &ht F12 EQUAL &kp BSPC       &kp INS   &kp HOME &kp PG_UP
                &kp KP_PLUS  &htL C_VOL_DN KP_N9  &htL C_MUTE KP_N8  &htL C_VOL_UP KP_N7      &kp TAB     &kp Q     &kp W      &kp E      &kp R     &kp T     &kp Y     &kp U     &kp I     &kp O    &kp P    &kp LBKT   &kp RBKT    &kp BSLH           &kp DEL   &kp END  &kp PG_DN
                             &ht C_PREV KP_N7     &ht C_PP KP_N6     &ht C_NEXT KP_N6         &lt 1 CLCK     &kp A      &kp S       &kp D      &kp F     &kp G     &kp H     &kp J     &kp K      &kp L    &kp SEMI     &kp SQT     &kp RET
                &kp KP_ENTER &kp KP_N3            &kp KP_N2          &kp KP_N1                &kp LSHFT       &kp Z     &kp X     &kp C       &kp V      &kp B      &kp N     &kp M    &kp COMMA   &kp DOT       &kp FSLH     &kp RSHFT                           &kp UP
                             &kp KP_DOT                      &kp KP_N0                        &kp LCTRL       &kp LGUI        &kp LALT                          &kp SPACE                               &kp RALT        &kp RGUI        &kp RCTRL       &kp LEFT  &kp DOWN &kp RIGHT
            >;
        };

        layer1 {

            //----------------------------------------------------------------------------------------------------------------------------
            //|CLR|   |   |CAL|  | ESC |  F1 |  F2 |  F3 |  F4 |  F5 |  F6 |  F7 |  F8 |  F9 | F10 | F11 | F12 |    DEL   |  |   |   |   |
            //| BT|   |   |BT1|  |PAUSE |     |  U  |     |     |     |     |     |     |     |     |     |     |         |  |   |   |   |
            //| LD|   |   |BT2|  | CAPS  |  L  |  D  |  R  |     |     |     |     |     |     |     |     |     ENTER    |   
            //| SY|   |   |BT3|  |  SHIFT  |     |     |     |     |     |     |     |     |     |     |      SHIFT       |      |   |
            //| CL| BT|  USB  |  |  CTL  |  WIN  |  ALT  |            SPACE                  |  ALT   |          |  CTRL  |  |   |   |   |
            //----------------------------------------------------------------------------------------------------------------------------

            bindings = <
                &bt BT_CLR   &none                &none              &kp K_CALC               &kp ESC  &kp F1    &kp F2    &kp F3    &kp F4    &kp F5    &kp F6    &kp F7     &kp F8    &kp F9    &kp F10    &kp F11       &kp F12       &kp BSPC       &kp PSCRN &kp SLCK &kp PAUSE_BREAK
                &bootloader  &none                &none              &bt BT_SEL 1             &kp C_PP     &none     &kp UP     &none      &none     &none     &none     &none     &none     &none    &none    &none      &none       &none             &kp DEL   &kp END  &kp PG_DN
                             &none                &none              &bt BT_SEL 2             &trans         &kp LEFT   &kp DOWN    &kp RIGHT  &none     &none     &none     &none     &none      &none    &none        &none      &kp RET
                &sys_reset   &none                &none              &bt BT_SEL 3             &kp LSHFT           &none       &none     &none     &none      &none      &none     &none    &none       &none       &none        &kp RSHFT                         &kp UP
                             &out OUT_BLE                  &out OUT_USB                       &kp LCTRL       &kp LGUI        &kp LALT                          &kp SPACE                               &kp RALT        &kp RGUI        &kp RCTRL       &kp LEFT  &kp DOWN &kp RIGHT
            >;
        };
    };
};